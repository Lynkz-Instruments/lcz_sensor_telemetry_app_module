## Kconfig
```kconfig
#
# Copyright (c) 2022 Laird Connectivity LLC
#
# SPDX-License-Identifier: LicenseRef-LairdConnectivity-Clause
#
menuconfig LCZ_SENSOR_TELEM_APP
	bool "LC sensor telemetry application"
	depends on ATTR
	depends on LCZ_LWM2M_GATEWAY_OBJ
	depends on LCZ_BT_SCAN
	depends on LCZ_AD_FIND
	depends on LCZ_SENSOR_ADV_MATCH
	depends on BT_EXT_ADV
	select LCZ_SENSOR_EVENT

if LCZ_SENSOR_TELEM_APP

module=LCZ_SENSOR_TELEM_APP
module-str=LCZ_SENSOR_TELEM_APP
source "subsys/logging/Kconfig.template.log_config"

config LCZ_SENSOR_APP_INIT_PRIORITY
	int "LC sensor app init priority (APPLICATION)"
	range 0 99
	default 99

config LCZ_SENSOR_APP_LED
	bool "Blink LED on sensor activity"
	depends on LCZ_LED

config LCZ_SENSOR_APP_TIMEOUT_SECONDS
	int "Maximum time between events"
	default 900
	help
	  If a new advertising event is not received in this amount of time, then
	  the device instance may be removed from the gateway.

config LCZ_SENSOR_APP_STATS
	bool "Collect statistics on advertisements"

config LCZ_SENSOR_TELEM_LOG_VERBOSE
	bool "Log event type, index, and RSSI at INF level"
	depends on LCZ_SENSOR_TELEM_APP_LOG_LEVEL >= LCZ_SENSOR_TELEM_APP_LOG_LEVEL_INF

config LCZ_SENSOR_CREATE_LOG_VERBOSE
	bool "Log attempted creation of blocked devices"
	depends on LCZ_SENSOR_TELEM_APP_LOG_LEVEL >= LCZ_SENSOR_TELEM_APP_LOG_LEVEL_DBG

choice
	prompt "Telemetry transport type"
	optional

config LCZ_SENSOR_TELEM_LWM2M
	bool "LC sensor telemetry reporting via LwM2M"
	depends on LCZ_LWM2M_UTIL_MANAGE_OBJ_INST

config LCZ_SENSOR_TELEM_MQTT
	bool "LC sensor telemetry reporting via MQTT"
	depends on LCZ_MQTT

config LCZ_SENSOR_SHELL
	bool "Enable Sensor Shell"
	depends on SHELL

endchoice

rsource "Kconfig.lcz_sensor_mqtt"

endif # LCZ_SENSOR_TELEM_APP
```

## Kconfig.lcz_sensor_mqtt
```kconfig
#
# Copyright (c) 2022 Laird Connectivity LLC
#
# SPDX-License-Identifier: LicenseRef-LairdConnectivity-Clause
#

if LCZ_SENSOR_TELEM_MQTT

config LCZ_MQTT_BLE_AD_LIST_SIZE
	int "Size in bytes of Advertisement List"
	range 65 4096
	default 1072

config LCZ_MQTT_BLE_PUBLISH_THRESHOLD
	int "Publish immediately if list size is past this threshold"
	range 1 4096
	default 768

config LCZ_MQTT_BLE_FIRST_PUBLISH
	int
	default 120
	help
	  Allow time for the gateway to initialize and connect to network

config LCZ_MQTT_PUBLISH_RATE
	int "Time in seconds between publishes of advertisement list"
	default 600

config LCZ_MQTT_ADV_AS_HEX_STRING_MAX_LEN
	int "Maximum size of advertisement data in hexadecimal"
	default 74

endif # LCZ_SENSOR_TELEM_MQTT
```
